## Kconfig
```kconfig
config SAMPLE_SUPPORT_SLE
    bool
    prompt "Support SLE sample."
    default n
    depends on ENABLE_DEMO_SAMPLE
    help
        This option means support SLE Sample.

config SAMPLE_SUPPORT_SLE_MESH
    bool
    prompt "Support SLE_MESH sample."
    default n
    depends on ENABLE_DEMO_SAMPLE
    help
        This option means support SLE_MESH Sample.
```
